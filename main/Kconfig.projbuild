## main/Kconfig.projbuild
```kconfig
menu "MAIN"

    config ESP_WIFI_SSID
        string "WiFi SSID"
        default "myssid"
        help
            SSID (network name) for the example to connect to.

    config ESP_WIFI_PASSWORD
        string "WiFi Password"
        default "mypassword"
        help
            WiFi password (WPA or WPA2) for the example to use.

    choice ESP_WIFI_SAE_MODE
        prompt "WPA3 SAE mode selection"
        default ESP_STATION_EXAMPLE_WPA3_SAE_PWE_BOTH
        help
            Select mode for SAE as Hunt and Peck, H2E or both.
        config ESP_STATION_EXAMPLE_WPA3_SAE_PWE_HUNT_AND_PECK
            bool "HUNT AND PECK"
        config ESP_STATION_EXAMPLE_WPA3_SAE_PWE_HASH_TO_ELEMENT
            bool "H2E"
            depends on ESP_WIFI_ENABLE_SAE_H2E
        config ESP_STATION_EXAMPLE_WPA3_SAE_PWE_BOTH
            bool "BOTH"
            depends on ESP_WIFI_ENABLE_SAE_H2E
    endchoice

    config ESP_WIFI_PW_ID
        string "PASSWORD IDENTIFIER"
        depends on  ESP_STATION_EXAMPLE_WPA3_SAE_PWE_HASH_TO_ELEMENT|| ESP_STATION_EXAMPLE_WPA3_SAE_PWE_BOTH
        default ""
        help
            password identifier for SAE H2E

    config ESP_MAXIMUM_RETRY
        int "Maximum retry"
        default 5
        help
            Set the Maximum retry to avoid station reconnecting to the AP unlimited when the AP is really inexistent.

    choice ESP_WIFI_SCAN_AUTH_MODE_THRESHOLD
        prompt "WiFi Scan auth mode threshold"
        default ESP_WIFI_AUTH_WPA2_PSK
        help
            The weakest authmode to accept in the scan mode.
            This value defaults to ESP_WIFI_AUTH_WPA2_PSK in case password is present and ESP_WIFI_AUTH_OPEN is used.
            Please select ESP_WIFI_AUTH_WEP/ESP_WIFI_AUTH_WPA_PSK in case AP is operating in WEP/WPA mode.

        config ESP_WIFI_AUTH_OPEN
            bool "OPEN"
        config ESP_WIFI_AUTH_WEP
            bool "WEP"
        config ESP_WIFI_AUTH_WPA_PSK
            bool "WPA PSK"
        config ESP_WIFI_AUTH_WPA2_PSK
            bool "WPA2 PSK"
        config ESP_WIFI_AUTH_WPA_WPA2_PSK
            bool "WPA/WPA2 PSK"
        config ESP_WIFI_AUTH_WPA3_PSK
            bool "WPA3 PSK"
        config ESP_WIFI_AUTH_WPA2_WPA3_PSK
            bool "WPA2/WPA3 PSK"
        config ESP_WIFI_AUTH_WAPI_PSK
            bool "WAPI PSK"
    endchoice

endmenu

menu "Player Configuration"

    config PLAYER_DEVICE_NAME
        string "Device display name"
        default "ESPSpotifyOS"
        help
            Friendly name shown on the OLED and used in logs.

    config PLAYER_SD_CS_GPIO
        int "SD card chip select GPIO"
        default 21
        help
            Chip-select line of the microSD slot.

    config PLAYER_SD_MOSI_GPIO
        int "SD SPI MOSI GPIO"
        default 11

    config PLAYER_SD_MISO_GPIO
        int "SD SPI MISO GPIO"
        default 12

    config PLAYER_SD_SCK_GPIO
        int "SD SPI SCK GPIO"
        default 14

    config PLAYER_SD_CD_GPIO
        int "SD card detect GPIO"
        default 47
        help
            Card-detect input. -1 = not connected (always attempt mount).

    config PLAYER_SD_MOUNT_POINT
        string "SD card mount point"
        default "/sdcard"
        help
            VFS mount point for the SD card.

    config PLAYER_MUSIC_DIR
        string "Music directory on SD card"
        default "/music"
        help
            Directory scanned for audio files for local playback.

    config PLAYER_MUSIC_MAX_FILES
        int "Maximum number of indexed music files"
        default 64
        help
            Upper bound for the local music library index.

    config PLAYER_TEST_TONE
        bool "Play a 440 Hz test tone at boot"
        default n
        help
            Enable to play a short test tone through the AUX DAC after startup,
            useful to verify the audio path without streaming.

    choice PLAYER_AUDIO_OUTPUT
        prompt "Audio output backend"
        default PLAYER_AUDIO_OUT_I2S
        help
            Where the decoded PCM is sent during playback.

        config PLAYER_AUDIO_OUT_SILENT
            bool "Silent (no audio hardware)"
            help
                Playback runs paced to real time but produces no audio.

        config PLAYER_AUDIO_OUT_I2S
            bool "External I2S DAC (PCM5102 AUX)"
            help
                Stereo 16-bit I2S output on the AUX pins below.

        config PLAYER_AUDIO_OUT_DAC
            bool "Onboard ESP32 DAC (legacy)"
            depends on IDF_TARGET_ESP32
            help
                Mono 8-bit output on the internal DAC. Not used on the
                ESP32-S3 custom PCB (use I2S/AUX instead).
    endchoice

    config PLAYER_AUDIO_EN_GPIO
        int "Speaker amplifier enable GPIO"
        default -1
        help
            GPIO that enables an onboard amplifier. -1 = none (AUX/PCM5102 board).

    config PLAYER_AUDIO_EN_ACTIVE_LOW
        bool "Amplifier enable is active-low"
        default y
        help
            Set if the amplifier is enabled by driving the enable GPIO low.

    config PLAYER_AUX_BCK_GPIO
        int "AUX I2S bit clock GPIO (PCM5102)"
        default 41
        depends on PLAYER_AUDIO_OUT_I2S
        help
            I2S bit-clock pin of the external DAC.

    config PLAYER_AUX_DIN_GPIO
        int "AUX I2S data GPIO (PCM5102)"
        default 40
        depends on PLAYER_AUDIO_OUT_I2S
        help
            I2S data pin of the external DAC.

    config PLAYER_AUX_LRCK_GPIO
        int "AUX I2S word-select GPIO (PCM5102)"
        default 39
        depends on PLAYER_AUDIO_OUT_I2S
        help
            I2S word-select pin of the external DAC.

    config PLAYER_AUX_SCK_GPIO
        int "AUX I2S master clock GPIO (PCM5102)"
        default 42
        depends on PLAYER_AUDIO_OUT_I2S
        help
            I2S master-clock pin of the external DAC. -1 = unused.

    config PLAYER_AUX_DET_GPIO
        int "AUX jack plug-detect GPIO"
        default 38
        help
            Input wired to the AUX jack insert switch. Reserved; unused for now.
            -1 = not connected.

    config PLAYER_BTN_CENTER_GPIO
        int "Center switch GPIO"
        default 4

    config PLAYER_BTN_BOTTOM_GPIO
        int "Bottom switch GPIO"
        default 15

    config PLAYER_BTN_TOP_GPIO
        int "Top switch GPIO"
        default 16

    config PLAYER_BTN_LEFT_GPIO
        int "Left switch GPIO"
        default 18

    config PLAYER_BTN_RIGHT_GPIO
        int "Right switch GPIO"
        default 17

    config PLAYER_SPOTIFY_CLIENT_ID
        string "Spotify Client ID"
        default ""
        help
            Client ID of your Spotify Developer app. Used by the PKCE OAuth flow;
            no client secret is stored on the device.

    config PLAYER_SPOTIFY_CLIENT_SECRET
        string "Spotify Client Secret"
        default ""
        help
            Client Secret of your Spotify Developer app to retrieve access token.

    config PLAYER_WEBSERVER_PORT
        int "Embedded web server port"
        default 8080
        help
            Port for the on-device HTTP server that serves the Spotify login
            page. The OAuth redirect URI registered in the Spotify Developer
            Dashboard must use the same port
            (http://127.0.0.1:PORT/callback).

    config PLAYER_AP_SSID
        string "Provisioning access point SSID"
        default "ESPSpotifyOS-Setup"
        help
            SSID broadcast when the device cannot connect to Wi-Fi and falls
            back to provisioning mode. Join it and open
            http://192.168.4.1:PORT/settings to set Wi-Fi credentials.

    config PLAYER_AP_PASSWORD
        string "Provisioning access point password"
        default "spotify-setup"
        help
            WPA2 password for the provisioning access point (at least 8
            characters). Leave empty for an open access point.

    config PLAYER_MEDIA_SERVICE_URL
        string "Media service base URL"
        default ""
        help
            Base URL of the companion media server, e.g. http://192.168.1.50:8081
            (no trailing slash). The ESP32 imports and streams tracks from here.
            Leave empty to disable the media client.

    config PLAYER_MEDIA_API_KEY
        string "Media service API key"
        default ""
        help
            Value of the SECRET variable from the media server's .env file.
            Sent as the X-API-Key header on every media service request.

    config PLAYER_VOLUME_STEP
        int "Volume step per press"
        default 5
        help
            Volume change applied by a single volume Up / Down press.

endmenu
```
